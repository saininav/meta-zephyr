## conf/distro/zephyr.conf
```bitbake
DISTRO = "zephyr"
DISTRO_NAME = "Zephyr"
DISTRO_VERSION = "1.0"

TARGET_VENDOR = "-yocto"

TCLIBC = "baremetal"
TCLIBCAPPEND = ""

TEST_TARGET = "QemuTargetZephyr"
TEST_SUITES = "zephyr"

TOOLCHAIN_TARGET_TASK += " newlib"
INHERIT += "siteinfo-zephyr"

INHERIT += "uninative"
require conf/distro/include/yocto-uninative.inc
```

## conf/layer.conf
```bitbake
# We have a conf and classes directory, add to BBPATH
BBPATH .= ":${LAYERDIR}"

# We have recipes-* directories, add to BBFILES
BBFILES += "${LAYERDIR}/recipes-*/*/*.bb \
	${LAYERDIR}/recipes-*/*/*.bbappend"

BBFILE_COLLECTIONS += "zephyr"
BBFILE_PATTERN_zephyr = "^${LAYERDIR}/"
BBFILE_PRIORITY_zephyr = "6"

# This should only be incremented on significant changes that will
# cause compatibility issues with other layers
LAYERVERSION_zephyr = "1"

LAYERDEPENDS_zephyr = "core"
```

## conf/machine/96b-nitrogen.conf
```bitbake
#@TYPE: Machine
#@NAME: 96b_nitrogen

#@DESCRIPTION: Machine configuration for 96Boards Nitrogen Board.

require conf/machine/include/nrf52832.inc
ARCH_96b-nitrogen = "arm"
```

## conf/machine/acrn.conf
```bitbake
#@TYPE: Machine
#@NAME: acrn
#@DESCRIPTION: Machine for Zephyr BOARD acrn

require conf/machine/include/qemu.inc
require conf/machine/include/tune-corei7-common.inc
ZEPHYR_INHERIT_CLASSES += "zephyr-qemuboot"

ARCH_acrn = "x86"
```

## conf/machine/arduino-101-ble.conf
```bitbake
#@TYPE: Machine
#@NAME: arduino-101-ble

#@DESCRIPTION: Machine configuration for Arduino 101 Board.

DEFAULTTUNE = "cortexm0"
require conf/machine/include/tune-cortexm0.inc

TARGET_LINK_HASH_STYLE = ""
ZEPHYR_INHERIT_CLASSES += "zephyr-flash-dfu"

ARCH_arduino-101-ble = "arm"
```

## conf/machine/arduino-101-sss.conf
```bitbake
#@TYPE: Machine
#@NAME: arduino-101-sss

#@DESCRIPTION: Machine configuration for Arduino 101 Board (ARC Core).

TUNE_FEATURES ="arc quark-se no-sdata no-delete-null-pointer-checks"

require conf/machine/include/tune-arc.inc
PACKAGE_EXTRA_ARCHS_tune-arc = "arc"

PREFERRED_VERSION_gcc-cross-${TARGET_ARCH} = "6.x.arc"
PREFERRED_VERSION_gcc-cross-canadian-${TRANSLATED_TARGET_ARCH} = "6.x.arc"
PREFERRED_VERSION_libgcc = "6.x.arc"

PREFERRED_VERSION_binutils-cross-${TARGET_ARCH} = "2.26+gitarc"
PREFERRED_VERSION_binutils-cross-canadian-${TRANSLATED_TARGET_ARCH} = "2.26+gitarc"

TARGET_LINK_HASH_STYLE = ""
ZEPHYR_INHERIT_CLASSES += "zephyr-flash-dfu"
```

## conf/machine/arduino-101.conf
```bitbake
#@TYPE: Machine
#@NAME: arduino-101

#@DESCRIPTION: Machine configuration for Arduino 101 Board.

TARGET_OS_arduino-101 = "elfiamcu"
require conf/machine/include/tune-iamcu.inc
TUNE_PKGARCH_arduino-101 = "iamcu"

TARGET_LINK_HASH_STYLE = ""
ZEPHYR_INHERIT_CLASSES += "zephyr-flash-dfu"
```

## conf/machine/arduino-nano-33-ble.conf
```bitbake
#@TYPE: Machine
#@NAME: arduino-nano-33-ble

#@DESCRIPTION: Machine configuration for Arudino nano 33 ble and Arduino nano 33 ble sense

require conf/machine/include/nrf52.inc
ARCH_arduino-nano-33-ble = "arm"
```

## conf/machine/include/nrf52832.inc
```bitbake
#@TYPE: Machine
#@NAME: nrf52832

#@DESCRIPTION: Machine configuration for Nordic Semiconductor nRF52832 (Cortex-M4) SoC.

require conf/machine/include/tune-cortexm4.inc

MACHINEOVERRIDES =. "nordic:"

TUNE_FEATURES = "armv7m cortexm4"

# Target type for this machine used by Pyocd
PYOCD_TARGET = "nrf52"
```

## conf/machine/include/stm32mp1-cortex-m4.inc
```bitbake
#@TYPE: Machine
#@NAME: stm32mp1-cortex-m4

#@DESCRIPTION: Machine configuration for Cortex-M4 core of STMicroelectronics STM32MP1 SoC.

require conf/machine/include/tune-cortexm4.inc

# Include OpenAMP for communication with Cortex-A7 core of the SoC
MACHINEOVERRIDES =. "stm32:openamp:"

TUNE_FEATURES = "armv7m cortexm4"
```

## conf/machine/include/tune-arc.inc
```bitbake
DEFAULTTUNE ?= "arc"

TUNE_ARCH = "arc"
TUNE_PKGARCH = "arc"
TUNE_FEATURES_tune-arc = "littleendian"
TUNE_CCARGS = ""

TUNEVALID[littleendian] = "Little endian mode"

TUNEVALID[quark-se] = "Intel Quark SE support (ARC core)"
TUNE_CCARGS .= "${@bb.utils.contains('TUNE_FEATURES', 'quark-se', ' -mcpu=quarkse_em', '', d)}"
AVAILTUNES += "quark-se"

TUNEVALID[nodata] = "ARC mo-sdata"
TUNE_CCARGS .= "${@bb.utils.contains('TUNE_FEATURES', 'no-sdata', ' -mno-sdata', '', d)}"
AVAILTUNES += "no-sdata"

TUNEVALID[nodata] = "ARC no-delete-null-pointer-checks"
TUNE_CCARGS .= "${@bb.utils.contains('TUNE_FEATURES', 'no-delete-null-pointer-checks', ' -fno-delete-null-pointer-checks', '', d)}"
AVAILTUNES += "no-delete-null-pointer-checks"
```

## conf/machine/include/tune-core2-common.inc
```bitbake
DEFAULTTUNE ?= "core2-32"
require conf/machine/include/tune-core2.inc
require conf/machine/include/x86-base.inc

# Add x86 to MACHINEOVERRIDES
MACHINEOVERRIDES =. "x86:"
```

## conf/machine/include/tune-corei7-common.inc
```bitbake
DEFAULTTUNE ?= "corei7-64"
require conf/machine/${X86_TUNE_DIR}/tune-corei7.inc
require conf/machine/${X86_TUNE_DIR}/x86-base.inc

# Add x86 to MACHINEOVERRIDE
MACHINEOVERRIDES =. "x86:"
```

## conf/machine/include/tune-cortexm0.inc
```bitbake
DEFAULTTUNE ?= "cortexm0"

require conf/machine/include/arm/arch-armv6.inc

TUNEVALID[cortexm0] = "Enable Cortex-M0 specific processor optimizations"
TUNE_CCARGS .= "${@bb.utils.contains('TUNE_FEATURES', 'cortexm0', ' -mcpu=cortex-m0', '', d)}"
AVAILTUNES += "cortexm0"

TUNEVALID[no-thumb-interwork] = "Enable thumb mode"
TUNE_CCARGS .= "${@bb.utils.contains('TUNE_FEATURES', 'no-thumb-interwork', ' -mno-thumb-interwork', '', d)}"
AVAILTUNES += "no-thumb-interwork"

TUNEVALID[no-ffast-math] = "Enable thumb mode"
TUNE_CCARGS .= "${@bb.utils.contains('TUNE_FEATURES', 'no-ffast-math', ' -fno-fast-math', '', d)}"
AVAILTUNES += "no-ffast-math"

TUNEVALID[soft] = "Enable thumb mode"
TUNE_CCARGS .= "${@bb.utils.contains('TUNE_FEATURES', 'soft', ' -mfloat-abi=soft', '', d)}"
AVAILTUNES += "soft"

TUNEVALID[armv6m] = "Enable Cortex-M0 specific processor optimizations"
TUNE_CCARGS .= "${@bb.utils.contains('TUNE_FEATURES', 'armv6m', ' -march=armv6-m', '', d)}"
MACHINEOVERRIDES =. "${@bb.utils.contains('TUNE_FEATURES', 'armv6m', 'armv6m:', '' ,d)}"

ARMPKGARCH:tune-cortexm0 = "cortexm0"
TUNE_FEATURES:tune-cortexm0 = "${TUNE_FEATURES:tune-armv6} cortexm0"

PACKAGE_EXTRA_ARCHS:tune-cortexm0 = "${PACKAGE_EXTRA_ARCHS:tune-armv6m} cortexm0-vfp"

TUNE_FEATURES:tune-cortexm0 = "armv6m vfp cortexm0 thumb no-thumb-interwork soft"
```

## conf/machine/include/tune-iamcu.inc
```bitbake
DEFAULTTUNE ?= "iamcu"

TARGET_OS_iamcu = "elfiamcu"
TARGET_ARCH = "i586"

TUNE_FEATURES_tune-iamcu = "iamcu"
TUNE_CCARGS = "-miamcu -m32"
TUNE_ARCH = "i586"
TUNEVALID[iamcu] = "Intel MCU"

PACKAGE_EXTRA_ARCHS_tune-iamcu = "iamcu"
```

## conf/machine/include/tune-nios2.inc
```bitbake
# Nios2 Architecture Definition

DEFAULTTUNE ?= "nios2"

TUNE_ARCH = "nios2"
TUNE_PKGARCH = "nios2"
TUNE_FEATURES_tune-nios2 = "nios2"
TUNE_CCARGS = ""

TUNEVALID[nios2] = "Altera Nios2"

PACKAGE_EXTRA_ARCHS_tune-nios2 = "nios2"
```

## conf/machine/intel-x86-32.conf
```bitbake
#@TYPE: Machine
#@NAME: intel-x86-32
#@DESCRIPTION: common MACHINE for 32-bit x86 boards. User must set ${ZEPHYR_BOARD}. By default is set to 'minnowboard' board.

require conf/machine/include/tune-core2-common.inc

ARCH_intel-x86-32 = "x86"

# Supported Boards:
# ZEPHYR_BOARD ?= "minnowboard"
# ZEPHYR_BOARD ?= "up_squared_32"
ZEPHYR_BOARD ?= "minnowboard"
```

## conf/machine/intel-x86-64.conf
```bitbake
#@TYPE: Machine
#@NAME: intel-x86-64
#@DESCRIPTION: common MACHINE for 64-bit x86 boards. User must set ${ZEPHYR_BOARD}. By default is set to 'ech_crb' board.

require conf/machine/include/tune-corei7-common.inc

ARCH:intel-x86-64 = "x86"

# Supported Boards:
# ZEPHYR_BOARD ?= "acrn"
# ZEPHYR_BOARD ?= "acrn_ehl_crb"
# ZEPHYR_BOARD ?= "up_squared"
# ZEPHYR_BOARD ?= "ehl_crb_sbl"
ZEPHYR_BOARD ?= "ehl_crb"
```

## conf/machine/minnowboard.conf
```bitbake
#@TYPE: Machine
#@NAME: minnowboard

#@DESCRIPTION: Machine configuration for Minnowboard XM.

DEFAULTTUNE ?= "core2-32"
require conf/machine/include/tune-core2.inc
require conf/machine/include/x86-base.inc

ARCH_minnowboard = "x86"
```

## conf/machine/qemu-cortex-m3.conf
```bitbake
#@TYPE: Machine
#@NAME: qemu-cortex-m3
#@DESCRIPTION: Machine for Zephyr BOARD qemu_cortex_m3

require conf/machine/include/qemu.inc
require conf/machine/include/tune-cortexm3.inc

# For runqemu (TBD)
QB_SYSTEM_NAME = "qemu-system-arm"
QB_MACHINE = "-machine lm3s6965evb"
QB_OPT_APPEND = "-nographic -vga none -cpu=cortex-m3"
```

## conf/machine/qemu-x86.conf
```bitbake
#@TYPE: Machine
#@NAME: qemu-x86
#@DESCRIPTION: Machine for Zephyr BOARD qemu_x86

require conf/machine/include/qemu.inc
require conf/machine/include/tune-i586.inc

# For runqemu (TBD)
QB_SYSTEM_NAME = "qemu-system-i386"
QB_MACHINE = "-machine pc-0.14"
QB_OPT_APPEND = "-nographic -display none -clock dynticks -no-acpi -balloon none"
```

## meta-zephyr-bsp/conf/machine/include/mimx8mq-cortex-m4.inc
```bitbake
#@TYPE: Machine
#@NAME: mimx8mq-cortex-m4

#@DESCRIPTION: Machine configuration for Cortex-M4 core of NXP MIMX8MQ SoC.

require conf/machine/include/arm/armv7m/tune-cortexm4.inc

TUNE_FEATURES = "armv7em cortexm4"
```

## meta-zephyr-bsp/conf/machine/include/nrf52.inc
```bitbake
#@TYPE: Machine
#@NAME: nrf52xxx

#@DESCRIPTION: Machine configuration for Nordic Semiconductor nRF52xxx (Cortex-M4) SoC.

require conf/machine/include/arm/armv7m/tune-cortexm4.inc

TUNE_FEATURES = "armv7em cortexm4"

# Target type for this machine used by Pyocd
PYOCD_TARGET = "nrf52"
```

## meta-zephyr-bsp/conf/machine/include/stm32mp1-cortex-m4.inc
```bitbake
#@TYPE: Machine
#@NAME: stm32mp1-cortex-m4

#@DESCRIPTION: Machine configuration for Cortex-M4 core of STMicroelectronics STM32MP1 SoC.

require conf/machine/include/arm/armv7m/tune-cortexm4.inc

TUNE_FEATURES = "armv7em cortexm4"
```
