## meta-zephyr-bsp/conf/machine/include/tune-corei7-common.inc
```bitbake
DEFAULTTUNE ?= "corei7-64"
require conf/machine/include/x86/tune-corei7.inc
require conf/machine/include/x86/x86-base.inc

# Add x86 to MACHINEOVERRIDE
MACHINEOVERRIDES =. "x86:"
```

## meta-zephyr-bsp/conf/machine/include/tune-cortexm3.inc
```bitbake
DEFAULTTUNE ?= "cortexm3"

require conf/machine/include/arm/arch-armv7a.inc

TUNEVALID[cortexm3] = "Enable Cortex-M3 specific processor optimizations"
TUNE_CCARGS .= "${@bb.utils.contains('TUNE_FEATURES', 'cortexm3', ' -mcpu=cortex-m3', '', d)}"
AVAILTUNES += "cortexm3"

TUNEVALID[armv7m] = "Enable Cortex-M3 specific processor optimizations"
TUNE_CCARGS .= "${@bb.utils.contains('TUNE_FEATURES', 'armv7m', ' -march=armv7-m', '', d)}"
MACHINEOVERRIDES =. "${@bb.utils.contains('TUNE_FEATURES', 'armv7m', 'armv7m:', '' ,d)}"

TUNE_PKGARCH:tune-cortexm3 = "cortexm3"

ARMPKGARCH:tune-cortexm3 = "armv7m"
PACKAGE_EXTRA_ARCHS:tune-cortexm3 ="cortexm3"

TUNE_FEATURES:tune-cortexm3 = "armv7m vfp cortexm3"
PACKAGE_EXTRA_ARCHS:tune-cortexm3 = "${PACKAGE_EXTRA_ARCHS:tune-armv7at} armv7m-vfp"

TUNE_CCARGS_MFLOAT = "soft"
```

## meta-zephyr-bsp/conf/machine/include/tune-cortexm4.inc
```bitbake
DEFAULTTUNE ?= "cortexm4"

require conf/machine/include/arm/arch-armv7a.inc

TUNEVALID[cortexm4] = "Enable Cortex-M4 specific processor optimizations"
TUNE_CCARGS .= "${@bb.utils.contains('TUNE_FEATURES', 'cortexm4', ' -mcpu=cortex-m4', '', d)}"
AVAILTUNES += "cortexm4"

TUNEVALID[armv7m] = "Enable Cortex-M4 specific processor optimizations"
TUNE_CCARGS .= "${@bb.utils.contains('TUNE_FEATURES', 'armv7m', ' -march=armv7e-m', '', d)}"
MACHINEOVERRIDES =. "${@bb.utils.contains('TUNE_FEATURES', 'armv7m', 'armv7m:', '' ,d)}"

TUNE_PKGARCH:tune-cortexm4 = "cortexm4"

ARMPKGARCH:tune-cortexm4 = "armv7m"
PACKAGE_EXTRA_ARCHS:tune-cortexm4 ="cortexm4"

TUNE_FEATURES:tune-cortexm4 = "armv7m vfp cortexm4"
PACKAGE_EXTRA_ARCHS:tune-cortexm4 = "${PACKAGE_EXTRA_ARCHS:tune-armv7at} armv7m-vfp armv7m"
```

## meta-zephyr-bsp/conf/machine/include/tune-nios2.inc
```bitbake
# Nios2 Architecture Definition

DEFAULTTUNE ?= "nios2"

TUNE_ARCH = "nios2"
TUNE_PKGARCH = "nios2"
TUNE_FEATURES:tune-nios2 = "nios2"
TUNE_CCARGS = ""

TUNEVALID[nios2] = "Altera Nios2"

PACKAGE_EXTRA_ARCHS:tune-nios2 = "nios2"
```

## meta-zephyr-bsp/conf/machine/mimx8mq_evk_cm4.conf
```bitbake
#@TYPE: Machine
#@NAME: mimx8mq_evk_cm4

#@DESCRIPTION: Machine configuration for mimx8mq_evk_cm4 Board.

require conf/machine/include/mimx8mq-cortex-m4.inc

ARCH:mimx8mq_evk_cm4 = "arm"
```

## meta-zephyr-bsp/conf/machine/qemu-cortex-m3.conf
```bitbake
#@TYPE: Machine
#@NAME: qemu-cortex-m3
#@DESCRIPTION: Machine for Zephyr BOARD qemu_cortex_m3

require conf/machine/include/qemu.inc
require conf/machine/include/tune-cortexm3.inc

ZEPHYR_INHERIT_CLASSES += "zephyr-qemuboot"

# For runqemu
QB_SYSTEM_NAME = "qemu-system-arm"
QB_MACHINE = "-machine lm3s6965evb"
QB_OPT_APPEND = "-nographic -vga none"
QB_CPU = "-cpu cortex-m3"
QB_RNG = ""

ARCH:qemu-cortex-m3 = "arm"
```

## meta-zephyr-core/conf/layer.conf
```bitbake
# We have a conf and classes directory, add to BBPATH
BBPATH .= ":${LAYERDIR}"

# We have recipes-* directories, add to BBFILES
BBFILES += "${LAYERDIR}/recipes-*/*/*.bb \
	${LAYERDIR}/recipes-*/*/*.bbappend"

BBFILE_COLLECTIONS += "zephyrcore"
BBFILE_PATTERN_zephyrcore = "^${LAYERDIR}/"
BBFILE_PRIORITY_zephyrcore = "6"

# This should only be incremented on significant changes that will
# cause compatibility issues with other layers
LAYERVERSION_zephyrcore = "1"

LAYERDEPENDS_zephyrcore = "core meta-python"

LAYERSERIES_COMPAT_zephyrcore = "dunfell gatesgarth hardknott honister"

X86_TUNE_DIR = "${@bb.utils.contains('LAYERSERIES_CORENAMES', 'honister', 'include/x86', 'include', d)}"

PYTHON3_NATIVE_SITEPACKAGES_DIR = "${libdir_native}/${PYTHON3_DIR}/site-packages"
```
